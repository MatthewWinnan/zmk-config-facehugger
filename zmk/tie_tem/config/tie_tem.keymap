/*
 * Copyright (c) 2023 The ZMK Contributors
 *
 * SPDX-License-Identifier: MIT
 */

// General imports
#include <behaviors.dtsi>
#include <dt-bindings/zmk/bt.h>
#include <dt-bindings/zmk/keys.h>
#include <dt-bindings/zmk/outputs.h>

// This is for auto layers
#include <behaviors/num_word.dtsi>

// #ifdef CONFIG_SHIELD_TIE_TEM_LEFT
// // We want to add my annoying fix if this is left side
// &kscan0 {
//     label = "KSCAN";
//     col-gpios
//         = <&xiao_d 6 GPIO_ACTIVE_HIGH>
//         , <&xiao_d 7 GPIO_ACTIVE_HIGH>
//         , <&xiao_d 10 GPIO_ACTIVE_HIGH>
//         , <&xiao_d 9 GPIO_ACTIVE_HIGH>
//         , <&xiao_d 8 GPIO_ACTIVE_HIGH>
//         ;
//
// /* This is because I messed up, I accidentally swapped my
//  * row 2 and 3, please uncomment when making it correctly
//  * unfortunately this gets applied after my local config, so we need to keep this
//  */
//     row-gpios
//         = <&xiao_d 0 (GPIO_ACTIVE_HIGH | GPIO_PULL_DOWN)>
//         , <&xiao_d 1 (GPIO_ACTIVE_HIGH | GPIO_PULL_DOWN)>
//         , <&xiao_d 3 (GPIO_ACTIVE_HIGH | GPIO_PULL_DOWN)>
//         , <&xiao_d 2 (GPIO_ACTIVE_HIGH | GPIO_PULL_DOWN)>
//         ;
// };
// #endif

// We define our layers
#define DEFAULT 0
// Almost like numpad, the idea is I expose numbers and arrow keys here?
#define NUMPAD 1
// We use this for window management navigation
#define WINDOW 2
// The idea here is we expose symbols I can use within VIM?
#define SYMBOLS 3
// The idea here is we need something for F keys and special num keys
#define SPECIAL 4
// The idea here is to allow me to change settings like BT, display, RGB etc
#define SETTINGS 5
// Special gaming layer to make gaming easier, still weird to toggle between layers for gaming :P
#define GAMING 6
// We need to get to numbers somehow, so we need this gaming layer too, only accessable through game layer
#define AGAMING 7

// Define some things that need to work with my window manager
#define MOD_KEY LGUI

// Pull in our helper scripts
#include "zmk-helpers/helper.h"
#include "zmk-helpers/key-labels/totem.h"
/*                                      38 KEY MATRIX / LAYOUT MAPPING

    ╭────────────────────┬────────────────────╮        ╭──────────────────────┬─────────────────────╮
    │  0   1   2   3   4 │  5   6   7   8   9 │        │  LT4 LT3 LT2 LT1 LT0 │ RT0 RT1 RT2 RT3 RT4 │
 ╭──╯ 10  11  12  13  14 │ 15  16  17  18  19 ╰───╮ ╭──╯  LM4 LM3 LM2 LM1 LM0 │ RM0 RM1 RM2 RM3 RM4 ╰───╮
 │ 20 21  22  23  24  25 │ 26  27  28  29  30  31 │ │ LB5 LB4 LB3 LB2 LB1 LB0 │ RB0 RB1 RB2 RB3 RB4 RB5 │
 ╰──────────╮ 32  33  34 │ 35  36  37 ╭───────────╯ ╰──────────╮  LH2 LH1 LH0 │ RH0 RH1 RH2 ╭───────────╯
            ╰────────────┴────────────╯                        ╰──────────────┴─────────────╯
*/

/* Global defaults */

#define QUICK_TAP_MS 175

&sk {
  release-after-ms = <900>;
  quick-release;
};

&sl { // Allow sticky mods to chord across sticky layers.
  ignore-modifiers;
};

// Defines my layer tap behavior
&lt {
  flavor = "balanced";
  tapping-term-ms = <200>;
  quick-tap-ms = <QUICK_TAP_MS>;
};

// Defines my CAPS word behavior
&caps_word {
    continue-list = <UNDERSCORE MINUS BACKSPACE>;
};

/* Homerow mods */

#define KEYS_L LT0 LT1 LT2 LT3 LT4 LM0 LM1 LM2 LM3 LM4 LB0 LB1 LB2 LB3 LB4 LB5
#define KEYS_R RT0 RT1 RT2 RT3 RT4 RM0 RM1 RM2 RM3 RM4 RB0 RB1 RB2 RB3 RB4 RB5
#define THUMBS LH2 LH1 LH0 RH0 RH1 RH2

#define MAKE_HRM(NAME, HOLD, TAP, TRIGGER_POS)                                 \
  ZMK_HOLD_TAP(NAME, bindings = <HOLD>, <TAP>; flavor = "balanced";            \
               tapping-term-ms = <280>; quick-tap-ms = <QUICK_TAP_MS>;         \
               require-prior-idle-ms = <150>; hold-trigger-on-release;         \
               hold-trigger-key-positions = <TRIGGER_POS>;)

MAKE_HRM(hml, &kp, &kp, KEYS_R THUMBS) // Left-hand HRMs.
MAKE_HRM(hmr, &kp, &kp, KEYS_L THUMBS) // Right-hand HRMs.

// Import our combo definition
#include "combos.dtsi"

// My pinky is rather weak so a larger timeout here
ZMK_TAP_DANCE(window_layer_dance, bindings = <&lm NUMPAD MOD_KEY>, <&win_layer WINDOW>; tapping-term-ms = <350>;)

// This is a simple dance so I can toggle my gaming layer and still have LCTRL
ZMK_TAP_DANCE(alt_game_dance, bindings = <&kp LCTRL>, <&mo AGAMING>; tapping-term-ms = <350>;)

// This is a simple dance so I can have LALT work, but still have the option to toggle to my NUMPAD layer
// This is more of a habit thing if I am navigating menus
// NUMPAD has the LALT key as trans, should then carry this one over right? so spamming ALT should still allow
// for alt dodge based games to work?
ZMK_TAP_DANCE(game_numpad_dance, bindings = <&sk LALT>, <&mo NUMPAD>; tapping-term-ms = <350>;)

// Simple macro that triggers the steam overlay
ZMK_BEHAVIOR(steam_overlay, macro,
  wait-ms = <100>;
  tap-ms = <5>;
  bindings = <&kp TAB &kp LSHIFT>;
)

// This is a dance that provides some useful gaming functions
// For now can toggle between steam overlay and screen shot
ZMK_TAP_DANCE(game_dance, bindings = <&steam_overlay>, <&kp F12>; tapping-term-ms = <350>;)


/ {
  behaviors {

  // Some macros
  /**
    * Temporarily switches to a layer (`&mo`) while a modifier is held.
    * Analogous to QMK's `LM()`, using a parameterized macro.
    *
    * Params:
    *  1. Layer to switch to
    *  2. Modifier to press while layer is active
    *
    * Example:
    *  `&lm NUM_LAYER LSHIFT`
    */

    lm: lm {
      compatible = "zmk,behavior-macro-two-param";
      wait-ms = <0>;
      tap-ms = <0>;
      #binding-cells = <2>;
      bindings
        = <&macro_param_1to1>
        , <&macro_press &mo MACRO_PLACEHOLDER>
        , <&macro_param_2to1>
        , <&macro_press &kp MACRO_PLACEHOLDER>
        , <&macro_pause_for_release>
        , <&macro_param_2to1>
        , <&macro_release &kp MACRO_PLACEHOLDER>
        , <&macro_param_1to1>
        , <&macro_release &mo MACRO_PLACEHOLDER>
        ;
    };


  // Tap dance behavior
  ctrl_dance: ctrl_dance {
            compatible = "zmk,behavior-tap-dance";
            label = "ctrl_dance";
            #binding-cells = <0>;
            tapping-term-ms = <450>;
            bindings = <&kp LCTRL>, <&lm NUMPAD LEFT_ALT>;
        };

  shift_dance: shift_dance {
            compatible = "zmk,behavior-tap-dance";
            label = "shift_dance";
            #binding-cells = <0>;
            tapping-term-ms = <450>;
            bindings = <&sk LSHIFT>, <&caps_word>;
        };

  numpad_layer_dance: numpad_layer_dance {
      compatible = "zmk,behavior-tap-dance";
      label = "numpad_layer_dance";
      #binding-cells = <0>;
      bindings = <&sl NUMPAD>, <&num_layer NUMPAD>;

      tapping-term-ms = <250>;
  };

  symbols_layer_dance: symbols_layer_dance {
      compatible = "zmk,behavior-tap-dance";
      label = "symbols_layer_dance";
      #binding-cells = <0>;
      bindings = <&mo SYMBOLS>, <&to SETTINGS>;

      tapping-term-ms = <250>;
  };

  // Custom auto layer behavior
  // Primarily used to input my ip address and for vim navigation
  num_layer: num_layer {
      compatible = "zmk,behavior-auto-layer";
      #binding-cells = <1>;
      continue-list = <BSPC DOT COMMA PLUS MINUS>;
      ignore-numbers;
      ignore-alphas;
      };

  // This is to be used for window management navigation
  win_layer: win_layer {
      compatible = "zmk,behavior-auto-layer";
      #binding-cells = <1>;
      continue-list = <GREATER_THAN LESS_THAN ENTER LEFT_ALT RIGHT LEFT DOWN UP_ARROW LEFT_SHIFT MOD_KEY>;
      ignore-numbers;
      ignore-alphas;
      };

  // General layer mapping
        keymap {
                compatible = "zmk,keymap";
// ▄▄▄▄▄▄▄▄▄▄▄▄▄▄▄▄▄▄▄▄▄▄▄▄▄▄▄▄▄▄▄▄▄▄▄▄▄▄▄▄▄▄▄▄▄▄▄▄▄▄▄▄▄▄▄▄▄▄▄▄▄▄▄▄▄▄▄▄▄▄▄▄▄▄▄▄▄▄▄▄▄▄▄▄▄▄▄▄▄▄▄▄▄▄▄▄▄▄▄▄▄▄▄▄▄▄▄▄▄▄▄▄▄▄▄▄▄▄▄▄▄▄▄▄▄▄▄▄▄▄▄▄▄▄▄▄▄▄▄▄▄▄▄▄▄▄▄▄▄

                default_layer {
// ┏━━━━━━━━━━━━━━━━━━━━━━━━━━━━━━━━━━━━━━━┓
display-name = "QWERTY"                    ;
// ┗━━━━━━━━━━━━━━━━━━━━━━━━━━━━━━━━━━━━━━━┛
//             ┏━━━━━━━━━━━┳━━━━━━━━━━━┳━━━━━━━━━━━┳━━━━━━━━━━━┳━━━━━━━━━━━┓   ┏━━━━━━━━━━━┳━━━━━━━━━━━┳━━━━━━━━━━━┳━━━━━━━━━━━┳━━━━━━━━━━━┓
//             ┃     Q     ┃     W     ┃     E     ┃     R     ┃     T     ┃   ┃     Y     ┃     U     ┃     I     ┃     O     ┃     P     ┃
//             ┣━━━━━━━━━━━╋━━━━━━━━━━━╋━━━━━━━━━━━╋━━━━━━━━━━━╋━━━━━━━━━━━┫   ┣━━━━━━━━━━━╋━━━━━━━━━━━╋━━━━━━━━━━━╋━━━━━━━━━━━╋━━━━━━━━━━━┫
//             ┃   A/ALT   ┃     S     ┃     D     ┃     F     ┃     G     ┃   ┃     H     ┃     J     ┃     K     ┃     L     ┃     ;/:     ┃
// ┏━━━━━━━━━━━╋━━━━━━━━━━━╋━━━━━━━━━━━╋━━━━━━━━━━━╋━━━━━━━━━━━╋━━━━━━━━━━━┫   ┣━━━━━━━━━━━╋━━━━━━━━━━━╋━━━━━━━━━━━╋━━━━━━━━━━━╋━━━━━━━━━━━╋━━━━━━━━━━━┓
// ┃bootloader ┃     Z     ┃     X     ┃     C     ┃     V     ┃     B     ┃   ┃     N     ┃     M     ┃     ,     ┃     .     ┃     /     ┃   window_layer_dance  ┃
// ┗━━━━━━━━━━━┻━━━━━━━━━━━┻━━━━━━━━━━━╋━━━━━━━━━━━╋━━━━━━━━━━━╋━━━━━━━━━━━┫   ┣━━━━━━━━━━━╋━━━━━━━━━━━╋━━━━━━━━━━━╋━━━━━━━━━━━┻━━━━━━━━━━━┻━━━━━━━━━━━┛
//                                     ┃    NLD    ┃    SPC    ┃ CTRLDANCE ┃   ┃     SD    ┃   ENTER   ┃    SLD    ┃
//                                     ┗━━━━━━━━━━━┻━━━━━━━━━━━┻━━━━━━━━━━━┛   ┗━━━━━━━━━━━┻━━━━━━━━━━━┻━━━━━━━━━━━┛
 bindings = <
// ╷           ╷           ╷           ╷           ╷           ╷           ╷   ╷           ╷           ╷           ╷           ╷           ╷           ╷
                &kp Q       &kp W       &kp E       &kp R       &kp T           &kp Y       &kp U       &kp I       &kp O       &kp P
                &hml LEFT_ALT A       &kp S       &kp D       &kp F       &kp G           &kp H       &kp J       &kp K       &kp L       &hmr SQT SEMI
    &window_layer_dance &kp Z       &kp X       &kp C       &kp V       &kp B           &kp N       &kp M       &kp COMMA   &kp DOT     &kp FSLH    &window_layer_dance
                                        &numpad_layer_dance   &kp SPACE   &ctrl_dance       &shift_dance &kp ENTER &symbols_layer_dance
                        >;
                };

// ▄▄▄▄▄▄▄▄▄▄▄▄▄▄▄▄▄▄▄▄▄▄▄▄▄▄▄▄▄▄▄▄▄▄▄▄▄▄▄▄▄▄▄▄▄▄▄▄▄▄▄▄▄▄▄▄▄▄▄▄▄▄▄▄▄▄▄▄▄▄▄▄▄▄▄▄▄▄▄▄▄▄▄▄▄▄▄▄▄▄▄▄▄▄▄▄▄▄▄▄▄▄▄▄▄▄▄▄▄▄▄▄▄▄▄▄▄▄▄▄▄▄▄▄▄▄▄▄▄▄▄▄▄▄▄▄▄▄▄▄▄▄▄▄▄▄▄▄▄


                numpad_layer {
// ┏━━━━━━━━━━━━━━━━━━━━━━━━━━━━━━━━━━━━━━━┓
display-name = "NUMPAD"                    ;
// ┗━━━━━━━━━━━━━━━━━━━━━━━━━━━━━━━━━━━━━━━┛
//             ┏━━━━━━━━━━━┳━━━━━━━━━━━┳━━━━━━━━━━━┳━━━━━━━━━━━┳━━━━━━━━━━━┓   ┏━━━━━━━━━━━┳━━━━━━━━━━━┳━━━━━━━━━━━┳━━━━━━━━━━━┳━━━━━━━━━━━┓
//             ┃     1     ┃     2     ┃     3     ┃     4     ┃     5     ┃   ┃     6     ┃     7     ┃     8     ┃     9     ┃     0     ┃
//             ┣━━━━━━━━━━━╋━━━━━━━━━━━╋━━━━━━━━━━━╋━━━━━━━━━━━╋━━━━━━━━━━━┫   ┣━━━━━━━━━━━╋━━━━━━━━━━━╋━━━━━━━━━━━╋━━━━━━━━━━━╋━━━━━━━━━━━┫
//             ┃     Q     ┃           ┃           ┃           ┃     T     ┃   ┃    LEFT   ┃   DOWN    ┃    UP     ┃   RIGHT   ┃     P     ┃
// ┏━━━━━━━━━━━╋━━━━━━━━━━━╋━━━━━━━━━━━╋━━━━━━━━━━━╋━━━━━━━━━━━╋━━━━━━━━━━━┫   ┣━━━━━━━━━━━╋━━━━━━━━━━━╋━━━━━━━━━━━╋━━━━━━━━━━━╋━━━━━━━━━━━╋━━━━━━━━━━━┓
// ┃           ┃           ┃           ┃           ┃           ┃           ┃   ┃           ┃           ┃           ┃           ┃           ┃           ┃
// ┗━━━━━━━━━━━┻━━━━━━━━━━━┻━━━━━━━━━━━╋━━━━━━━━━━━╋━━━━━━━━━━━╋━━━━━━━━━━━┫   ┣━━━━━━━━━━━╋━━━━━━━━━━━╋━━━━━━━━━━━╋━━━━━━━━━━━┻━━━━━━━━━━━┻━━━━━━━━━━━┛
//                                     ┃           ┃           ┃           ┃   ┃           ┃           ┃           ┃
//                                     ┗━━━━━━━━━━━┻━━━━━━━━━━━┻━━━━━━━━━━━┛   ┗━━━━━━━━━━━┻━━━━━━━━━━━┻━━━━━━━━━━━┛
 bindings = <
// ╷           ╷           ╷           ╷           ╷           ╷           ╷   ╷           ╷           ╷           ╷           ╷           ╷           ╷

                &kp N1      &kp N2      &kp N3      &kp N4      &kp N5          &kp N6      &kp N7      &kp N8      &kp N9      &kp N0
                &kp Q      &trans      &trans      &trans      &kp T           &kp LEFT    &kp DOWN    &kp UP_ARROW  &kp RIGHT  &kp P    &trans
                                        &trans      &trans      &trans          &trans      &trans   &trans
                        >;
                };

// ▄▄▄▄▄▄▄▄▄▄▄▄▄▄▄▄▄▄▄▄▄▄▄▄▄▄▄▄▄▄▄▄▄▄▄▄▄▄▄▄▄▄▄▄▄▄▄▄▄▄▄▄▄▄▄▄▄▄▄▄▄▄▄▄▄▄▄▄▄▄▄▄▄▄▄▄▄▄▄▄▄▄▄▄▄▄▄▄▄▄▄▄▄▄▄▄▄▄▄▄▄▄▄▄▄▄▄▄▄▄▄▄▄▄▄▄▄▄▄▄▄▄▄▄▄▄▄▄▄▄▄▄▄▄▄▄▄▄▄▄▄▄▄▄▄▄▄▄▄

window_layer {
// ┏━━━━━━━━━━━━━━━━━━━━━━━━━━━━━━━━━━━━━━━┓
display-name = "WINDOW"                    ;
// ┗━━━━━━━━━━━━━━━━━━━━━━━━━━━━━━━━━━━━━━━┛
// Specialized layer for my window manager, follows many of the same conventions as NUMPAD layer, with some added commands useful for hyprland
            bindings = <
              &kp LG(N1)  &kp LG(N2)  &kp LG(N3)  &kp LG(N4)  &kp LG(N5)                                  &kp LG(N6)    &kp LG(N7)    &kp LG(N8)        &kp LG(N9)     &kp LG(N0)
              &kp LG(Q)   &trans      &kp LG(D)   &kp LG(F)   &kp LG(T)                                  &kp LG(LEFT)  &kp LG(DOWN)  &kp LG(UP_ARROW)  &kp LG(RIGHT)  &kp LG(P)
    &trans    &trans      &trans      &kp LG(C)   &trans      &kp LG(TAB)             &trans  &kp LG(LESS_THAN)    &kp LG(GREATER_THAN)        &trans     &trans    &trans
                          &trans  &trans  &trans                              &trans  &kp LG(ENTER)  &trans
            >;
        };


symbols_layer {
// ┏━━━━━━━━━━━━━━━━━━━━━━━━━━━━━━━━━━━━━━━┓
display-name= "SYMBOLS"                               ;
// ┗━━━━━━━━━━━━━━━━━━━━━━━━━━━━━━━━━━━━━━━┛
//             ┏━━━━━━━━━━━┳━━━━━━━━━━━┳━━━━━━━━━━━┳━━━━━━━━━━━┳━━━━━━━━━━━┓   ┏━━━━━━━━━━━┳━━━━━━━━━━━┳━━━━━━━━━━━┳━━━━━━━━━━━┳━━━━━━━━━━━┓
//             ┃           ┃           ┃     {     ┃     }     ┃     #     ┃   ┃     <     ┃     >     ┃     $     ┃     @     ┃     |     ┃
//             ┣━━━━━━━━━━━╋━━━━━━━━━━━╋━━━━━━━━━━━╋━━━━━━━━━━━╋━━━━━━━━━━━┫   ┣━━━━━━━━━━━╋━━━━━━━━━━━╋━━━━━━━━━━━╋━━━━━━━━━━━╋━━━━━━━━━━━┫
//             ┃     &     ┃           ┃     [     ┃     ]     ┃     \     ┃   ┃     =     ┃     !     ┃     *     ┃     _     ┃     ;     ┃
// ┏━━━━━━━━━━━╋━━━━━━━━━━━╋━━━━━━━━━━━╋━━━━━━━━━━━╋━━━━━━━━━━━╋━━━━━━━━━━━┫   ┣━━━━━━━━━━━╋━━━━━━━━━━━╋━━━━━━━━━━━╋━━━━━━━━━━━╋━━━━━━━━━━━╋━━━━━━━━━━━┓
// ┃           ┃           ┃           ┃     (     ┃     )     ┃     ^     ┃   ┃     -     ┃     +     ┃           ┃           ┃           ┃           ┃
// ┗━━━━━━━━━━━┻━━━━━━━━━━━┻━━━━━━━━━━━╋━━━━━━━━━━━╋━━━━━━━━━━━╋━━━━━━━━━━━┫   ┣━━━━━━━━━━━╋━━━━━━━━━━━╋━━━━━━━━━━━╋━━━━━━━━━━━┻━━━━━━━━━━━┻━━━━━━━━━━━┛
//                                     ┃           ┃           ┃           ┃   ┃           ┃           ┃           ┃
//                                     ┗━━━━━━━━━━━┻━━━━━━━━━━━┻━━━━━━━━━━━┛   ┗━━━━━━━━━━━┻━━━━━━━━━━━┻━━━━━━━━━━━┛
 bindings = <
// ╷           ╷           ╷           ╷           ╷           ╷           ╷   ╷           ╷           ╷           ╷           ╷           ╷           ╷

                &trans  &trans  &kp LEFT_BRACE &kp RIGHT_BRACE &kp HASH       &kp LESS_THAN  &kp GREATER_THAN  &kp DOLLAR    &kp AT_SIGN &kp PIPE
                &kp AMPERSAND  &kp GRAVE  &kp LBKT &kp RBKT &kp BACKSLASH          &kp EQUAL      &kp EXCLAMATION   &kp ASTERISK  &kp UNDERSCORE  &trans
    &to SETTINGS &trans      &trans  &kp LEFT_PARENTHESIS  &kp RIGHT_PARENTHESIS &kp CARET          &kp MINUS         &kp PLUS          &trans        &trans          &trans    &to SPECIAL
                             &trans      &trans      &trans          &trans      &trans      &trans
                        >;
      };

special_layer {
// ┏━━━━━━━━━━━━━━━━━━━━━━━━━━━━━━━━━━━━━━━┓
display-name = "SPECIAL"                           ;
// ┗━━━━━━━━━━━━━━━━━━━━━━━━━━━━━━━━━━━━━━━┛
//             ┏━━━━━━━━━━━┳━━━━━━━━━━━┳━━━━━━━━━━━┳━━━━━━━━━━━┳━━━━━━━━━━━┓   ┏━━━━━━━━━━━┳━━━━━━━━━━━┳━━━━━━━━━━━┳━━━━━━━━━━━┳━━━━━━━━━━━┓
//             ┃    F1     ┃     F2    ┃     F3    ┃     F4    ┃     F5    ┃   ┃     F6    ┃     F7    ┃     F8    ┃     F9    ┃     F10   ┃
//             ┣━━━━━━━━━━━╋━━━━━━━━━━━╋━━━━━━━━━━━╋━━━━━━━━━━━╋━━━━━━━━━━━┫   ┣━━━━━━━━━━━╋━━━━━━━━━━━╋━━━━━━━━━━━╋━━━━━━━━━━━╋━━━━━━━━━━━┫
//             ┃  PAGE_UP  ┃    F11    ┃     F12   ┃     F13   ┃     F14   ┃   ┃     F15   ┃     F16   ┃     F17   ┃   INSERT  ┃    HOME   ┃
// ┏━━━━━━━━━━━╋━━━━━━━━━━━╋━━━━━━━━━━━╋━━━━━━━━━━━╋━━━━━━━━━━━╋━━━━━━━━━━━┫   ┣━━━━━━━━━━━╋━━━━━━━━━━━╋━━━━━━━━━━━╋━━━━━━━━━━━╋━━━━━━━━━━━╋━━━━━━━━━━━┓
// ┃  DEFAULT  ┃ PAGE_DOWN ┃    F18    ┃     F19   ┃     F20   ┃     F21   ┃   ┃     F22   ┃     F23   ┃     F24   ┃   DELETE  ┃    END    ┃   DEFAULT ┃
// ┗━━━━━━━━━━━┻━━━━━━━━━━━┻━━━━━━━━━━━╋━━━━━━━━━━━╋━━━━━━━━━━━╋━━━━━━━━━━━┫   ┣━━━━━━━━━━━╋━━━━━━━━━━━╋━━━━━━━━━━━╋━━━━━━━━━━━┻━━━━━━━━━━━┻━━━━━━━━━━━┛
//                                     ┃           ┃           ┃           ┃   ┃           ┃           ┃           ┃
//                                     ┗━━━━━━━━━━━┻━━━━━━━━━━━┻━━━━━━━━━━━┛   ┗━━━━━━━━━━━┻━━━━━━━━━━━┻━━━━━━━━━━━┛
 bindings = <
// ╷           ╷           ╷           ╷           ╷           ╷           ╷   ╷           ╷           ╷           ╷           ╷           ╷           ╷

                &kp F1  &kp F2  &kp F3   &kp F4   &kp F5                &kp F6   &kp F7   &kp F8   &kp F9      &kp F10
                &kp PAGE_UP  &kp F11  &kp F12  &kp F13  &kp F14          &kp F15  &kp F16  &kp F17  &kp INSERT  &kp HOME
  &to GAMING   &kp PAGE_UP  &kp F18  &kp F19  &kp F20  &kp F21          &kp F22  &kp F23  &kp F24  &kp DELETE  &kp END    &to SETTINGS
                             &trans      &trans      &to DEFAULT          &to DEFAULT      &trans      &trans
                        >;
                };

settings_layer {
// ┏━━━━━━━━━━━━━━━━━━━━━━━━━━━━━━━━━━━━━━━┓
display-name= "SETTINGS"                               ;
// ┗━━━━━━━━━━━━━━━━━━━━━━━━━━━━━━━━━━━━━━━┛
//             ┏━━━━━━━━━━━┳━━━━━━━━━━━┳━━━━━━━━━━━┳━━━━━━━━━━━┳━━━━━━━━━━━┓   ┏━━━━━━━━━━━┳━━━━━━━━━━━┳━━━━━━━━━━━┳━━━━━━━━━━━┳━━━━━━━━━━━┓
//             ┃    BT 0   ┃    BT 1   ┃    BT 2   ┃    BT 3   ┃     BT 4  ┃   ┃           ┃           ┃           ┃           ┃           ┃
//             ┣━━━━━━━━━━━╋━━━━━━━━━━━╋━━━━━━━━━━━╋━━━━━━━━━━━╋━━━━━━━━━━━┫   ┣━━━━━━━━━━━╋━━━━━━━━━━━╋━━━━━━━━━━━╋━━━━━━━━━━━╋━━━━━━━━━━━┫
//             ┃           ┃           ┃           ┃   BT_CLR  ┃ BT_CLR_ALL┃   ┃           ┃           ┃           ┃           ┃           ┃
// ┏━━━━━━━━━━━╋━━━━━━━━━━━╋━━━━━━━━━━━╋━━━━━━━━━━━╋━━━━━━━━━━━╋━━━━━━━━━━━┫   ┣━━━━━━━━━━━╋━━━━━━━━━━━╋━━━━━━━━━━━╋━━━━━━━━━━━╋━━━━━━━━━━━╋━━━━━━━━━━━┓
// ┃ SYS_RESET ┃           ┃           ┃           ┃           ┃           ┃   ┃           ┃           ┃           ┃           ┃           ┃ SYS_RESET ┃
// ┗━━━━━━━━━━━┻━━━━━━━━━━━┻━━━━━━━━━━━╋━━━━━━━━━━━╋━━━━━━━━━━━╋━━━━━━━━━━━┫   ┣━━━━━━━━━━━╋━━━━━━━━━━━╋━━━━━━━━━━━╋━━━━━━━━━━━┻━━━━━━━━━━━┻━━━━━━━━━━━┛
//                                     ┃           ┃    BOOT   ┃  DEFAULT  ┃   ┃           ┃           ┃  DEFAULT  ┃
//                                     ┗━━━━━━━━━━━┻━━━━━━━━━━━┻━━━━━━━━━━━┛   ┗━━━━━━━━━━━┻━━━━━━━━━━━┻━━━━━━━━━━━┛
 bindings = <
// ╷           ╷           ╷           ╷           ╷           ╷           ╷   ╷           ╷           ╷           ╷           ╷           ╷           ╷

                &bt BT_SEL 0  &bt BT_SEL 1  &bt BT_SEL 2  &bt BT_SEL 3  &bt BT_SEL 4         &trans        &trans        &trans        &trans        &trans
                &trans        &trans        &trans        &bt BT_CLR    &bt BT_CLR_ALL       &trans        &trans        &trans        &trans        &trans  &sys_reset
    &sys_reset  &trans        &trans        &trans        &trans        &trans               &trans        &trans        &trans        &trans        &trans
                                            &trans   &bootloader      &to DEFAULT            &trans        &trans        &to DEFAULT
                        >;
                };

gaming_layer {
// ┏━━━━━━━━━━━━━━━━━━━━━━━━━━━━━━━━━━━━━━━┓
display-name= "GAME"                               ;
// ┗━━━━━━━━━━━━━━━━━━━━━━━━━━━━━━━━━━━━━━━┛
 bindings = <
              &hml TAB T &kp Q  &kp W  &kp E   &kp R                                        &kp Y       &kp U       &kp I       &kp O       &kp P
              &hml LSHIFT G &kp A  &kp S  &kp D   &kp F                                     &kp H       &kp J       &kp K       &kp L       &hmr SQT SEMI
   &game_dance  &kp Z &kp X  &kp C  &kp V   &kp B                                     &kp N       &kp M       &kp COMMA   &kp DOT     &kp FSLH    &window_layer_dance
                                  &game_numpad_dance  &kp SPACE  &alt_game_dance                      &shift_dance &kp ENTER &to DEFAULT
            >;
                };

alt_gaming_layer {
// ┏━━━━━━━━━━━━━━━━━━━━━━━━━━━━━━━━━━━━━━━┓
display-name= "AGAME"                               ;
// ┗━━━━━━━━━━━━━━━━━━━━━━━━━━━━━━━━━━━━━━━┛
 bindings = <
              &kp N1 &kp N2 &kp N3 &kp N4  &kp N5                                            &kp N6       &kp N7       &kp N8       &kp N9       &kp N0
              &trans &trans  &kp I  &kp J   &trans                                     &kp H       &kp J       &kp K       &kp L       &hmr SQT SEMI
   &trans     &kp Z &kp X  &kp C  &kp V   &kp B                                     &kp N       &kp M       &kp COMMA   &kp DOT     &kp FSLH    &window_layer_dance
                                  &trans  &kp ENTER  &kp TAB                      &shift_dance &kp ENTER &to DEFAULT
            >;
                };
        };
    };
};
